## ESP-IDF-HDDESP32/hddesp32/sdkconfig.defaults
```kconfig
# ESP32 4MB Flash Configuration - MEMORY OPTIMIZED

# Flash Configuration
CONFIG_ESPTOOLPY_FLASHSIZE_4MB=y
CONFIG_ESPTOOLPY_FLASHSIZE="4MB"
CONFIG_ESPTOOLPY_FLASHMODE_DIO=y
CONFIG_ESPTOOLPY_FLASHFREQ_40M=y

# Partitions
CONFIG_PARTITION_TABLE_CUSTOM=y
CONFIG_PARTITION_TABLE_CUSTOM_FILENAME="partitions.csv"
CONFIG_PARTITION_TABLE_FILENAME="partitions.csv"

# CPU and Performance
CONFIG_ESP_DEFAULT_CPU_FREQ_MHZ_240=y
CONFIG_ESP_DEFAULT_CPU_FREQ_MHZ=240

# Compiler Optimizations
CONFIG_COMPILER_OPTIMIZATION_SIZE=y
CONFIG_COMPILER_OPTIMIZATION_ASSERTIONS_ENABLE=y

# Memory Management - OPTIMIZADO
CONFIG_ESP_MAIN_TASK_STACK_SIZE=8192
CONFIG_ESP_SYSTEM_EVENT_TASK_STACK_SIZE=8192
CONFIG_ESP_TIMER_TASK_STACK_SIZE=4096

# FreeRTOS Configuration - OPTIMIZADO
CONFIG_FREERTOS_HZ=100
CONFIG_FREERTOS_IDLE_TASK_STACKSIZE=3072
CONFIG_FREERTOS_TIMER_TASK_STACK_DEPTH=4096
CONFIG_FREERTOS_USE_TIMERS=y
CONFIG_FREERTOS_CHECK_STACKOVERFLOW_PTRVAL=y
CONFIG_FREERTOS_CHECK_STACKOVERFLOW_CANARY=y

# WiFi Configuration - OPTIMIZADO
CONFIG_ESP_WIFI_DYNAMIC_RX_BUFFER_NUM=16
CONFIG_ESP_WIFI_DYNAMIC_TX_BUFFER_NUM=16
CONFIG_ESP_WIFI_STATIC_RX_BUFFER_NUM=8
CONFIG_ESP_WIFI_RX_BA_WIN=8
CONFIG_ESP_WIFI_TX_BA_WIN=8
CONFIG_ESP_WIFI_AMPDU_TX_ENABLED=y
CONFIG_ESP_WIFI_AMPDU_RX_ENABLED=y
CONFIG_ESP_WIFI_NVS_ENABLED=y

# LWIP Configuration - OPTIMIZADO
CONFIG_LWIP_TCPIP_TASK_STACK_SIZE=6144
CONFIG_LWIP_TCP_SND_BUF_DEFAULT=8192
CONFIG_LWIP_TCP_WND_DEFAULT=8192
CONFIG_LWIP_TCP_RECVMBOX_SIZE=24
CONFIG_LWIP_UDP_RECVMBOX_SIZE=24
CONFIG_LWIP_TCPIP_RECVMBOX_SIZE=48
CONFIG_LWIP_DNS_MAX_SERVERS=3
CONFIG_LWIP_DHCP_GET_NTP_SRV=y
CONFIG_LWIP_DHCP_RESTORE_LAST_IP=y

# MQTT Configuration - OPTIMIZADO
CONFIG_MQTT_BUFFER_SIZE=1536
CONFIG_MQTT_TASK_STACK_SIZE=6144
CONFIG_MQTT_PROTOCOL_311=y
CONFIG_MQTT_TRANSPORT_SSL=y
CONFIG_MQTT_TRANSPORT_WEBSOCKET=y
CONFIG_MQTT_TRANSPORT_WEBSOCKET_SECURE=y

# mbedTLS Configuration
CONFIG_MBEDTLS_CERTIFICATE_BUNDLE=y
CONFIG_MBEDTLS_CERTIFICATE_BUNDLE_DEFAULT_FULL=y
CONFIG_MBEDTLS_CERTIFICATE_BUNDLE_MAX_CERTS=200
CONFIG_MBEDTLS_SSL_IN_CONTENT_LEN=16384
CONFIG_MBEDTLS_SSL_OUT_CONTENT_LEN=8192
CONFIG_MBEDTLS_TLS_CLIENT=y
CONFIG_MBEDTLS_TLS_SERVER=y

# HTTP Server Configuration - OPTIMIZADO
CONFIG_HTTPD_TASK_STACK_SIZE=5120
CONFIG_HTTPD_MAX_REQ_HDR_LEN=1024
CONFIG_HTTPD_MAX_URI_LEN=512

# NVS Configuration
CONFIG_NVS_ENCRYPTION=y

# Log Configuration
CONFIG_LOG_DEFAULT_LEVEL_INFO=y
CONFIG_LOG_DEFAULT_LEVEL=3
CONFIG_LOG_MAXIMUM_LEVEL=3

# WATCHDOG CONFIGURATION - SIEMPRE ACTIVO Y ROBUSTO
CONFIG_ESP_TASK_WDT_EN=y
CONFIG_ESP_TASK_WDT_INIT=y
CONFIG_ESP_TASK_WDT_TIMEOUT_S=30
CONFIG_ESP_TASK_WDT_CHECK_IDLE_TASK_CPU0=y
CONFIG_ESP_TASK_WDT_CHECK_IDLE_TASK_CPU1=y

# Interrupt Watchdog Configuration - Robusto
CONFIG_ESP_INT_WDT=y
CONFIG_ESP_INT_WDT_TIMEOUT_MS=2000
CONFIG_ESP_INT_WDT_CHECK_CPU1=y

# System Configuration - Producción
CONFIG_ESP_SYSTEM_PANIC_PRINT_HALT=y
CONFIG_ESP_SYSTEM_PANIC_REBOOT_DELAY_SECONDS=5

# Memory Protection
CONFIG_HEAP_POISONING_DISABLED=y
CONFIG_HEAP_TRACING_OFF=y
CONFIG_HEAP_ALLOCATION_STRATEGY_MIN_FRAGMENT=y

# Core Dump Configuration
CONFIG_ESP_COREDUMP_ENABLE_TO_FLASH=y
CONFIG_ESP_COREDUMP_DATA_FORMAT_ELF=y
CONFIG_ESP_COREDUMP_MAX_TASKS_NUM=64

# ESP Timer Configuration
CONFIG_ESP_TIMER_INTERRUPT_LEVEL=1
CONFIG_ESP_TIMER_TASK_AFFINITY=0x0
CONFIG_ESP_TIMER_TASK_STACK_SIZE=4096

# Bootloader Configuration - Robusto
CONFIG_BOOTLOADER_COMPILER_OPTIMIZATION_SIZE=y
CONFIG_BOOTLOADER_LOG_LEVEL_INFO=y
CONFIG_BOOTLOADER_WDT_ENABLE=y
CONFIG_BOOTLOADER_WDT_TIME_MS=20000

# ESP System - Robusto
CONFIG_ESP_SYSTEM_EVENT_QUEUE_SIZE=128
CONFIG_ESP_CONSOLE_UART_BAUDRATE=115200

# SPI Flash Configuration
CONFIG_SPI_FLASH_YIELD_DURING_ERASE=y
CONFIG_SPI_FLASH_ERASE_YIELD_DURATION_MS=20
CONFIG_SPI_FLASH_WRITE_CHUNK_SIZE=8192
CONFIG_SPI_FLASH_DANGEROUS_WRITE_ABORTS=y

# Power Management
CONFIG_PM_ENABLE=n

# Bluetooth Disabled
CONFIG_BT_ENABLED=n

# ESP32 Specific
CONFIG_ESP32_WIFI_AMPDU_TX_ENABLED=y
CONFIG_ESP32_WIFI_AMPDU_RX_ENABLED=y
CONFIG_ESP32_WIFI_NVS_ENABLED=y

# Debug Configuration
CONFIG_ESP_ERR_TO_NAME_LOOKUP=y
CONFIG_ESP_SYSTEM_CHECK_INT_LEVEL_5=y
CONFIG_COMPILER_HIDE_PATHS_MACROS=y

# Brownout Detection - Seguridad
CONFIG_ESP_BROWNOUT_DET=y
CONFIG_ESP_BROWNOUT_DET_LVL=0
CONFIG_ESP_SYSTEM_BROWNOUT_INTR=y

# Network Stack - OPTIMIZADO
CONFIG_TCPIP_TASK_STACK_SIZE=6144
CONFIG_TCPIP_TASK_AFFINITY_NO_AFFINITY=y

# GPIO Configuration
CONFIG_GPIO_ESP32_SUPPORT_SWITCH_SLP_PULL=y

# Additional Production Safety
CONFIG_ESP_SLEEP_GPIO_ENABLE_INTERNAL_RESISTORS=y
CONFIG_ESP_SLEEP_FLASH_LEAKAGE_WORKAROUND=y
CONFIG_ESP_SLEEP_RTC_BUS_ISO_WORKAROUND=y

# FreeRTOS Additional Safety
CONFIG_FREERTOS_WATCHPOINT_END_OF_STACK=y
CONFIG_FREERTOS_TLSP_DELETION_CALLBACKS=y
CONFIG_FREERTOS_CHECK_MUTEX_GIVEN_BY_OWNER=y
CONFIG_FREERTOS_INTERRUPT_BACKTRACE=y

# HAL Configuration
CONFIG_HAL_ASSERTION_EQUALS_SYSTEM=y
CONFIG_HAL_DEFAULT_ASSERTION_LEVEL=2

# SPI Driver Configuration
CONFIG_SPI_MASTER_ISR_IN_IRAM=y
CONFIG_SPI_SLAVE_ISR_IN_IRAM=y

# ESP Driver GPIO Configuration
CONFIG_GPIO_CTRL_FUNC_IN_IRAM=y

# ESP Timer Configuration
CONFIG_GPTIMER_ISR_HANDLER_IN_IRAM=y
CONFIG_GPTIMER_CTRL_FUNC_IN_IRAM=y

# Memory Allocation
CONFIG_SPIRAM_SUPPORT=n
```
